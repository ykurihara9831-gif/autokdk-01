## boards/shields/1770475423436/Kconfig.defconfig
```kconfig
if SHIELD_1770475423436_LEFT

config ZMK_KEYBOARD_NAME
    default "1770475423436"

endif

if SHIELD_1770475423436_LEFT || SHIELD_1770475423436_RIGHT

config ZMK_SPLIT
    default y

endif
```

## boards/shields/1770475423436/Kconfig.shield
```kconfig
config SHIELD_1770475423436_LEFT
    def_bool $(shields_list_contains,1770475423436_left)
config SHIELD_1770475423436_RIGHT
    def_bool $(shields_list_contains,1770475423436_right)
```
